## arch/arm64/Kconfig.debug
```kconfig
# SPDX-License-Identifier: GPL-2.0-only

config PID_IN_CONTEXTIDR
	bool "Write the current PID to the CONTEXTIDR register"
	help
	  Enabling this option causes the kernel to write the current PID to
	  the CONTEXTIDR register, at the expense of some additional
	  instructions during context switch. Say Y here only if you are
	  planning to use hardware trace tools with this kernel.

config DEBUG_EFI
	depends on EFI && DEBUG_INFO
	bool "UEFI debugging"
	help
	  Enable this option to include EFI specific debugging features into
	  the kernel that are only useful when using a debug build of the
	  UEFI firmware

config ARM64_RELOC_TEST
	depends on m
	tristate "Relocation testing module"

config UNWINDER_ORC
	bool "ORC unwinder"
	depends on FRAME_POINTER_VALIDATION
	select HAVE_MOD_ARCH_SPECIFIC
	help
	  This option enables ORC (Oops Rewind Capability) for ARM64. This
	  allows the unwinder to look up ORC data for an instruction address
	  and compute the frame pointer at that address. The computed frame
	  pointer is used to validate the actual frame pointer.

config FRAME_POINTER_VALIDATION
	bool "Dynamic Frame pointer validation"
	depends on FRAME_POINTER
	select UNWINDER_ORC
	help
		This invokes objtool on every object file causing it to
		generate ORC data for the object file. ORC data is in a custom
		data format which is a simplified version of the DWARF
		Call Frame Information standard. See UNWINDER_ORC for more
		details.

source "drivers/hwtracing/coresight/Kconfig"
```
